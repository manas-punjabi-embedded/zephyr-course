## Kconfig
```
config APP_HEARTBEAT_PERIOD_MS
    int "Heartbeat LED period (ms)"
    range 100 2000
    default 500
    help
      How long the heartbeat LED waits between toggles.

menuconfig LED_SUBSYSTEM
    bool "LED Subsystem"
    default y
    help
      Enable the LED blink application settings.

if LED_SUBSYSTEM

choice
    prompt "LED blink sleep time"
    default BLINK_SLEEP_1000_MS

config BLINK_SLEEP_250_MS
    bool "250ms (fast)"

config BLINK_SLEEP_1000_MS
    bool "1s (medium)"

config BLINK_SLEEP_2000_MS
    bool "2s (slow)"

endchoice

menuconfig LED_ADVANCED
    bool "Advanced LED settings"
    default n

if LED_ADVANCED

config LED_BRIGHTNESS
    int "LED brightness (0-100)"
    range 0 100
    default 100

config LED_FADE_DURATION_MS
    int "LED fade duration (ms)"
    default 500

menu "Expert settings"

config LED_DEBUG
    bool "Enable LED debugging"

config LED_CUSTOM_PATTERN
    bool "Custom blink pattern"

endmenu

endif # LED_ADVANCED

endif # LED_SUBSYSTEM


config BLINK_SLEEP_TIME_MS
    int
    default 250 if BLINK_SLEEP_250_MS
    default 1000 if BLINK_SLEEP_1000_MS
    default 2000 if BLINK_SLEEP_2000_MS
    default 1000

source "Kconfig.zephyr"
```

## prj.conf
```kconfig
CONFIG_GPIO=y
CONFIG_LOG=y


CONFIG_BLINK_SLEEP_250_MS=y
```

## boards/esp32_devkitc_procpu.overlay
```dts
/ {
    aliases {
        led0 = &led0;
        app-led = &led0;
    };

    leds {
        compatible = "gpio-leds";
        led0: led_0 {
            gpios = <&gpio0 2 GPIO_ACTIVE_HIGH>;
        };
    };
};
```

## src/main.cpp
```c
#include <zephyr/drivers/gpio.h>
#include <zephyr/kernel.h>
#include <zephyr/logging/log.h>


/* The devicetree node identifier for the "app-led" alias. */
#define LED_NODE DT_ALIAS(app_led)

static const struct gpio_dt_spec led = GPIO_DT_SPEC_GET(LED_NODE, gpios);

LOG_MODULE_REGISTER(main, LOG_LEVEL_INF);

int main(void)
{
    bool led_state = true;

    if (!gpio_is_ready_dt(&led)) return 0;

    if (gpio_pin_configure_dt(&led, GPIO_OUTPUT_ACTIVE) < 0) return 0;

    while (1) {
        if (gpio_pin_toggle_dt(&led) < 0) return 0;

        led_state = !led_state;
        LOG_INF("LED state: %s", led_state ? "ON" : "OFF");
        k_msleep(CONFIG_APP_HEARTBEAT_PERIOD_MS);
    }
    return 0;
}
```
